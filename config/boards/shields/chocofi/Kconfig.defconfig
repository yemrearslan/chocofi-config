## config/boards/shields/chocofi/Kconfig.defconfig
```kconfig
if SHIELD_CHOCOFI_LEFT || SHIELD_CHOCOFI_RIGHT

config ZMK_KEYBOARD_NAME
    default "Chocofi"

config ZMK_SPLIT
    default y

endif
```
